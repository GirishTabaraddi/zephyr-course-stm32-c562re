## app/boards/copy_rename_custom_board/Kconfig.copy_rename_custom_board
```kconfig
# Copyright (c) 2026 STMicroelectronics
# SPDX-License-Identifier: Apache-2.0

config BOARD_COPY_RENAME_CUSTOM_BOARD
	bool "Copy Rename Custom Board"
	default y
	select SOC_STM32C562XX
```

## app/boards/copy_rename_custom_board/board.yml
```yaml
board:
  name: copy_rename_custom_board
  full_name: Copy Rename Custom Board
  vendor: iomico
  socs:
    - name: stm32c562xx
```

## app/boards/from_scratch_custom_board/Kconfig.from_scratch_custom_board
```kconfig
config BOARD_FROM_SCRATCH_CUSTOM_BOARD
    bool "From Scratch Custom Board"
    default y
    select SOC_STM32C562XX
```

## app/boards/from_scratch_custom_board/board.yml
```yaml
board:
  name: from_scratch_custom_board
  full_name: From Scratch Custom Board
  vendor: iomico
  socs:
    - name: stm32c562xx
```

## app/boards/my_board/Kconfig.my_board
```kconfig
config BOARD_MY_BOARD
    bool "My Board"
    default y
    select SOC_STM32C562XX
```

## app/boards/test_board/Kconfig.test_board
```kconfig
# Copyright (c) 2026 STMicroelectronics
# SPDX-License-Identifier: Apache-2.0

config BOARD_OUR_BOARD
	bool "Test Board"
	default y
	select SOC_STM32C562XX
```

## app/boards/test_board/board.yml
```yaml
board:
  name: test_board
  full_name: Test Board
  vendor: iomico
  socs:
    - name: stm32c562xx
```

## app/drivers/l6task1_led_driver/Kconfig
```kconfig
menu "L6TASK1 ON BOARD LED Driver"

config L6TASK1_ON_BOARD_LED_DRIVER
    bool "Enable L6TASK1 ON BOARD LED Driver"
    default y
    help
      Enable the L6TASK1 ON BOARD LED driver for controlling the on-board LED.

endmenu

if SHELL

choice
    prompt "Select LED Sensor Shell Version"
    default L7_TASK2_SHELL

    config L7_TASK1_SHELL
        bool "Task 1 Shell (Basic info, fetch, read)"
        
    config L7_TASK2_SHELL
        bool "Task 2 Shell (Adds 'set' command with validation)"
endchoice

endif # CONFIG_SHELL
```

## app/drivers/our_driver/Kconfig
```kconfig
config OUR_DRIVER
    bool "Our Driver"
    default y
    help
      Enable this option to include our custom driver in the build.
```
